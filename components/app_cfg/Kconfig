## components/app_cfg/Kconfig
```kconfig
menu "app_cfg -- device configuration"

config APP_CFG_NAMESPACE
    string "NVS namespace for application configuration"
    default "appcfg"
    help
        Every persistent setting the template owns lives in this one namespace, so a
        factory reset has a single, auditable definition.

config APP_CFG_PERSIST_PARTITION
    string "NVS partition for data that survives a factory reset"
    default "persist"
    help
        Label of a second NVS partition, opened with app_cfg_persist_open(). A factory
        reset, Wi-Fi provisioning (tools/provision_nvs.sh, which rewrites the main nvs
        partition) and /api/forget leave it alone, so it is the place for anything that
        must never go backwards: a monotonic counter, a network join nonce, a pairing.

config APP_CFG_AP_PASS_SALT
    string "SoftAP passphrase salt"
    default "esp32-lorawan-node"
    help
        Mixed with the device MAC to derive the provisioning AP passphrase. The default
        is public, so anyone can compute any device's passphrase from the MAC its SSID
        advertises. Set your own in sdkconfig.local, which git ignores:
            CONFIG_APP_CFG_AP_PASS_SALT="<random string>"

config APP_CFG_AP_PASS_FIXED
    string "Fixed SoftAP passphrase (empty = derive per device)"
    default ""
    help
        Leave empty in anything you ship. A fixed passphrase is convenient on a bench
        where you provision the same board repeatedly and would rather not read the
        boot log every time.

endmenu
```

## components/app_led/Kconfig
```kconfig
menu "app_led -- status LED"

choice APP_LED_TYPE
    prompt "Status LED type"
    default APP_LED_TYPE_NONE
    help
        Devkits disagree about the status LED: a plain GPIO on some boards, an
        addressable WS2812 on many ESP32-S3 and C6 kits, and the pin moves between
        boards carrying the same chip. Set this in sdkconfig.defaults.<target>, never
        in application code.

config APP_LED_TYPE_NONE
    bool "None -- build without a status LED"

config APP_LED_TYPE_GPIO
    bool "Plain GPIO"

config APP_LED_TYPE_ADDRESSABLE
    bool "Addressable (WS2812 over RMT)"
    depends on SOC_RMT_SUPPORTED
    help
        Gated on the RMT peripheral rather than on a chip name, so a target without RMT
        falls back to a build that simply has no addressable option -- not to a build
        error.

endchoice

config APP_LED_GPIO
    int "Status LED GPIO number"
    default 48
    depends on !APP_LED_TYPE_NONE

config APP_LED_ACTIVE_LOW
    bool "LED is active low"
    default n
    depends on APP_LED_TYPE_GPIO

config APP_LED_BRIGHTNESS
    int "Addressable LED brightness (1-255)"
    range 1 255
    default 24
    depends on APP_LED_TYPE_ADDRESSABLE
    help
        Devkit WS2812s are painfully bright at full scale, and a status light does not
        need to be.

config APP_LED_TASK_STACK
    int "LED task stack size"
    default 2560
    depends on !APP_LED_TYPE_NONE

endmenu
```

## components/app_lora/Kconfig
```kconfig
menu "app_lora -- LoRaWAN link (RadioLib, SX1276)"

config APP_LORA_ENABLE
    bool "Enable the LoRaWAN link"
    default y

if APP_LORA_ENABLE

config APP_LORA_DEV_EUI
    string "DevEUI (16 hex digits, MSB first)"
    default ""
    help
        From the device's page in the TTN console. Set it in sdkconfig.local, which git
        ignores, together with the JoinEUI and AppKey.

config APP_LORA_JOIN_EUI
    string "JoinEUI / AppEUI (16 hex digits, MSB first)"
    default "0000000000000000"

config APP_LORA_APP_KEY
    string "AppKey (32 hex digits, MSB first)"
    default ""
    help
        LoRaWAN 1.0.4 root key. Secret: anyone holding it can impersonate the device.

config APP_LORA_HEARTBEAT_S
    int "Seconds between heartbeat uplinks"
    default 900
    range 60 86400

config APP_LORA_JOIN_RETRY_MAX_S
    int "Longest wait between join attempts"
    default 900
    range 60 3600

menu "Radio pins (defaults: Heltec WiFi LoRa 32 V2)"
    config APP_LORA_PIN_SCK
        int "SCK"
        default 5
    config APP_LORA_PIN_MISO
        int "MISO"
        default 19
    config APP_LORA_PIN_MOSI
        int "MOSI"
        default 27
    config APP_LORA_PIN_NSS
        int "NSS (chip select)"
        default 18
    config APP_LORA_PIN_RST
        int "RESET"
        default 14
    config APP_LORA_PIN_DIO0
        int "DIO0"
        default 26
    config APP_LORA_PIN_DIO1
        int "DIO1"
        default 35
endmenu

endif

endmenu
```

## main/Kconfig.projbuild
```kconfig
menu "Project"

config APP_PROJECT_NAME_SLUG
    string "Project slug"
    default "esp32-lorawan-node"
    help
        Used for the mDNS hostname and the provisioning AP SSID, both of which become
        `<slug>-<last 3 MAC bytes>`. Must be a valid DNS label: lowercase letters,
        digits and hyphens only.

        One of the three things to change when you copy this template into a new
        project -- the others are project() in the top-level CMakeLists.txt and
        APP_CFG_AP_PASS_SALT. See "Forking this template" in README.md.

menu "Shed I/O (defaults: Heltec WiFi LoRa 32 V2)"

config SHED_BUTTON_GPIO
    int "PRG button GPIO (active low)"
    default 0

config SHED_IN1_GPIO
    int "Input 1 GPIO (active low, internal pull-up; -1 = unused)"
    default 32
    help
        Wire a contact (door switch, reed relay) between this pin and GND.

config SHED_IN2_GPIO
    int "Input 2 GPIO (active low, internal pull-up; -1 = unused)"
    default 33

config SHED_OUT1_GPIO
    int "Output 1 GPIO (-1 = unused)"
    default 23

config SHED_OUT2_GPIO
    int "Output 2 GPIO (-1 = unused)"
    default 22

config SHED_OUT_ACTIVE_HIGH
    bool "Outputs are active high"
    default y
    help
        Turn off for relay boards that switch on a low input.

endmenu

menu "Status display (defaults: Heltec WiFi LoRa 32 V2)"

config SHED_DISPLAY_ENABLE
    bool "Show status on an SSD1306 128x64 I2C OLED"
    default y if IDF_TARGET_ESP32
    help
        LoRaWAN, Wi-Fi, input and output state. Without a panel the node logs one
        warning at boot and carries on. On by default only for the ESP32, the Heltec V2's
        chip: on other boards the default pins below may be the console or flash.

if SHED_DISPLAY_ENABLE

config SHED_DISPLAY_SDA_GPIO
    int "SDA GPIO"
    default 4

config SHED_DISPLAY_SCL_GPIO
    int "SCL GPIO"
    default 15

config SHED_DISPLAY_RST_GPIO
    int "Reset GPIO (-1 = none)"
    default 16

config SHED_DISPLAY_VEXT_GPIO
    int "Panel power enable GPIO, active low (-1 = none)"
    default 21
    help
        Heltec boards power the OLED from Vext, switched by this pin. It also powers the
        Vext header pin.

config SHED_DISPLAY_TIMEOUT_S
    int "Seconds before the screen turns off (0 = never)"
    default 120
    range 0 86400
    help
        OLEDs burn in. The screen comes back on with any input or output change: the PRG
        button, a contact, or a command from the network. A button press also sends its
        usual uplink.

config SHED_DISPLAY_FLIP
    bool "Rotate 180 degrees"
    default n

endif

endmenu

endmenu
```
